## hachidori/main/Kconfig.projbuild
```kconfig
menu "Hachidori Configuration"

config AP_ADDRESS
    string "IPv4 address of this adaptor as a Wi-Fi AP"
    default "192.168.11.1"
    help
        This adaptor's Wi-Fi address

config SSID
    string "WIFI access point name (SSID)"
    default "hachidori_ap"
    help
        Enter the name of the WIFI access point

config SSID_PASSWORD
    string "WIFI password"
    default "e15f44ecdff3a"
    help
        Enter ssid password

config UDP_SERVER_ADDRESS
    string "IPv4 address of UDP server"
    default "192.168.11.1"
    help
        IP address of the UDP server, normaly same with AP_ADDRESS

config UDP_PORT
    int "UDP port"
    default 5790
    help
        UDP port used for both Wi-Fi and ether

config PACKET_BUNDLE
    bool "Enable packet bundle"
    default "n"
    help
        If enabled, sensor packets can be bundled into one udp packet.

config BARO_MS5611
    bool "Enable MS5611"
    default "y"
    help
        If enabled, MS5611 is used as barometer.

config ESC
    bool "Enable standard PWM for ESC"
    default "n"
    help
	If enabled, outputs 1100us-1900us standard PWM signals for ESC.
	Otherwise generates 16kHz PWM for coreless motors.

config ESC_MCPWM
    bool "Enable Motor Control PWM unit"
    default "n"
    help
	If enabled, Motor Control PWM unit is used to generate PWM.
	Otherwise, LED Control unit is used.

config MOTOR_ORDER_CW
    bool "Enable clockwise motor order"
    default "n"
    help
	If enabled, clockwise motor order is used. Otherwise APM
	motor order is used.

config ROTATION_YAW
    int "Rotation Yaw"
    default 90
    help
	Yaw rotation difference from the frame head to the IMU north.
	Only 0, 90, 180 and 270 are legal.

config RGBLED_ON
    int "Logic value for lighting REGLED"
    default 1
    help
	Value for lighting RGB LED. 1 for positive logic and 0 for
	negative logic.

config GPIO_LED_RED
    int "GPIO for RED color of RGBLED"
    default 15
    help
	GPIO number used for RED color element.

config GPIO_LED_GREEN
    int "GPIO for GREEN color of RGBLED"
    default 4
    help
	GPIO number used for GREEN color element.

config GPIO_LED_BLUE
    int "GPIO for BLUE color of RGBLED"
    default 2
    help
	GPIO number used for BLUE color element.

config FILTER_CONVERGE_COUNT
    int "MadgwickAHRS filter calibration time in ms"
    default 6000
    help
        Time(ms) for MadgwickAHRS filter calibration.

endmenu
```
